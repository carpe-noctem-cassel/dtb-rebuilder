/*
 * Copyright (C) 2012 Texas Instruments Incorporated - http://www.ti.com/
 *
 * This program is free software; you can redistribute it and/or modify
 * it under the terms of the GNU General Public License version 2 as
 * published by the Free Software Foundation.
 */
/dts-v1/;

#include "am33xx.dtsi"
// #include "am33xx-es2.dtsi"
#include "am335x-bone-common.dtsi"
// #include "am33xx-overlay-edma-fix.dtsi"

/ {
	model = "TI AM335x BeagleBone Black";
	compatible = "ti,am335x-bone-black", "ti,am335x-bone", "ti,am33xx";
};

&ldo3_reg {
	regulator-min-microvolt = <1800000>;
	regulator-max-microvolt = <1800000>;
	regulator-always-on;
};

&mmc1 {
	vmmc-supply = <&vmmcsd_fixed>;
};

&mmc2 {
	vmmc-supply = <&vmmcsd_fixed>;
	pinctrl-names = "default";
	pinctrl-0 = <&emmc_pins>;
	bus-width = <8>;
	status = "okay";
};


// HDMI
//#include "cn-am335x-boneblack-hdmi.dtsi"
//&lcdc {
//	status = "okay";
//};

// I2C2
//#include "am335x-bone-pinmux-i2c2.dtsi"

// PWM (modified by CNC)
//#include "cn-am335x-boneblack-ehrpwm.dtsi"

// CAN1
//#include "am335x-bone-pinmux-can1.dtsi"

// ADC
//&tscadc {
      //  status = "okay";
    //    adc {
          //      ti,adc-channels = <0 1 2 3 4 5 6>;
        //        ti,chan-step-avg = <0x16 0x16 0x16 0x16 0x16 0x16 0x16>;
      //          ti,chan-step-opendelay = <0x98 0x98 0x98 0x98 0x98 0x98 0x98>;
    //            ti,chan-step-sampledelay = <0x0 0x0 0x0 0x0 0x0 0x0 0x0>;
  //      };
//};

// SPI0
#include "cn-am335x-bone-pinmux-spi0.dtsi"
